## meta-rz-bsp/conf/machine/solidrun-rzg2lc-hummingboard.conf
```bitbake
#@TYPE: Machine
#@NAME: solidrun-rzg2lc-hummingboard
#@DESCRIPTION: Machine configuration for SolidRun RZ/G2LC HummingBoard Ripple EVK

require include/rzg2l-family.inc

# Linux kernel configuration
PREFERRED_PROVIDER_virtual/kernel = "linux-solidrun"
PREFERRED_VERSION_linux-solidrun  = "5.10.%"
KERNEL_DEVICETREE_BASENAME = "rzg2lc-hummingboard"
KBUILD_DEFCONFIG = "rz-solidrun_defconfig"
MACHINE_ESSENTIAL_EXTRA_RDEPENDS += " \
	linux-firmware-bcm43439 \
	linux-firmware-bcm-0bb4-0306 \
"
KERNEL_DEVICETREE:append = " \
	renesas/rzg2lc-solidrun-som-sd.dtbo \
	renesas/rzg2lc-solidrun-som-mmc.dtbo \
	renesas/rzg2lc-solidrun-som-phy.dtbo \
"

# U-Boot configuration
PREFERRED_PROVIDER_virtual/bootloader = "u-boot-solidrun"
UBOOT_MACHINE ?= "rzg2lc-solidrun_defconfig"

# TF-A configuration
TFA_PLATFORM ?= "g2l"
TFA_EXTRA_OEMAKE = " \
	BOARD=sr_rzg2lc_1g \
	FIP_ALIGN=16 \
"

# Flash Writer configuration
FLASH_WRITER_BOARD ?= "RZG2LC_SMARC"
```
